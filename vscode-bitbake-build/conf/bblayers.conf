## vscode-bitbake-build/conf/bblayers.conf
```bitbake
# POKY_BBLAYERS_CONF_VERSION is increased each time build/conf/bblayers.conf
# changes incompatibly
POKY_BBLAYERS_CONF_VERSION = "2"

BBPATH = "${TOPDIR}"
BBFILES ?= ""

BBLAYERS ?= " \
  /home/kwalsh/workspace/poky/meta \
  /home/kwalsh/workspace/poky/meta-poky \
  /home/kwalsh/workspace/poky/meta-yocto-bsp \
  "
```
